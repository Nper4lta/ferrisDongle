## boards/shields/cradio/Kconfig.defconfig
```kconfig
# Defconfig
#
# Created: July 29 2025
# Edited: 2025-Aug-16 11:45


if SHIELD_CRADIO_DONGLE

config ZMK_SPLIT
   default y

config ZMK_KEYBOARD_NAME
    default "ばか"

config ZMK_SPLIT_ROLE_CENTRAL
    default y

# Set number of peripherals the dongle will have
# 1 for unibody while 2 for left and right and then etc

config ZMK_SPLIT_BLE_CENTRAL_PERIPHERALS
    default 2

# set number of peripherals and desired number of BT profiles

config BT_MAX_CONN
    default 6

# Set to the same number as BT_MAX_CONN

# config BT_MAX_PAIRED
#    default 6

# config CONFIG_ZMK_SPLIT_BLE 
#    default y

# config ZMK_SPLIT_PERIPHERAL_HID_INDICATORS=y

endif

if SHIELD_CRADIO_LEFT || SHIELD_CRADIO__RIGHT

 # Battery Levels    
#CONFIG_BT_BAS=y

#CONFIG_ZMK_BATTERY_REPORTING=y
#CONFIG_ZMK_SPLIT_BLE_CENTRAL_BATTERY_LEVEL_PROXY=y 
#CONFIG_ZMK_SPLIT_BLE_CENTRAL_BATTERY_LEVEL_FETCHING=y

#CONFIG_ZMK_SPLIT_BLE_CENTRAL_BATTERY_LEVEL_PROXY=y
#CONFIG_ZMK_SPLIT_BLE_CENTRAL_BATTERY_LEVEL_QUEUE_SIZE=3
#CONFIG_ZMK_SPLIT_BLE_CENTRAL_BATTERY_LEVEL_FETCHING=y

# config ZMK_SPLIT_PERIPHERAL_HID_INDICATORS=y

config ZMK_SPLIT
   default y

config ZMK_SPLIT_ROLE_CENTRAL
    default n

# config CONFIG_ZMK_SPLIT_BLE 
#    default y

endif
```

## boards/shields/cradio/Kconfig.shield
```kconfig
# The Kconfig shield
#
# Created: July 29 2025
# Edited: July 29 2025


config SHIELD_CRADIO_DONGLE
    def_bool $(shields_list_contains,cradio_dongle)

config SHIELD_CRADIO_RIGHT
    def_bool $(shields_list_contains,cradio_right)

config SHIELD_CRADIO_LEFT
    def_bool $(shields_list_contains,cradio_left)
```

## boards/shields/ferris_dongle/Kconfig.defconfig
```kconfig
# Defconfig
#
# Created by: Nathan Peralta
# Created: July 29 2025
# Edited: July 29 2025


if SHIELD_FERRIS_DONGLE

config ZMK_KEYBOARD_NAME
    default "Nper4lta"

config ZMK_SPLIT_ROLE_CENTRAL
    default y

config ZMK_SPLIT
    default y

# Set number of peripherals the dongle will have
# 1 for unibody while 2 for left and right and then etc

config ZMK_SPLIT_BLE_CENTRAL_PERIPHERALS
    default 2

# set number of peripherals and desired number of BT profiles 

config BT_MAX_CONN
    default 6

# Set to the same number as BT_MAX_CONN

config BT_MAX_PAIRED
    default 6

endif

if SHIELD_CRADIO_LEFT || SHIELD_CRADIO__RIGHT

config ZMK_SPLIT
    default y

endif
```

## boards/shields/ferris_dongle/Kconfig.shield
```kconfig
# The Kconfig shield
#
# Created: July 29 2025
# Edited: July 29 2025


config SHIELD_FERRIS_DONGLE
    def_bool $(shields_list_contains,ferris_dongle)

config SHIELD_CRADIO_LEFT
    def_bool $(shields_list_contains,cradio_left)

config SHIELD_CRADIO__RIGHT
    def_bool $(shields_list_contains,cradio_right)
```
